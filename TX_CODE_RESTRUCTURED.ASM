
; PICBASIC PRO(TM) Compiler 3.1.6.2, (c) 1997, 2022 ME Labs, Inc. All Rights Reserved. 
MPASMX_USED			EQU	1

#define	PBP_PATH	C:\PROGRAM FILES (X86)\PBP3_1\




        NOLIST
    ifdef PM_USED
        LIST
        "Error: PM does not support this device.  Use MPASM."
        NOLIST
    else
        LIST
        LIST p = 18F2550, r = dec, w = -311, w = -230, f = inhx32
        INCLUDE "P18F2550.INC"	; MPASM  Header
        NOLIST
    endif
        LIST
EEPROM_START	EQU	0F00000h
BLOCK_SIZE	EQU	32


PBP_HARDWAREDEF  macro
  endm


    CONFIG  PLLDIV = 5            ; Divide by 5 (20 MHz oscillator input)
    CONFIG  CPUDIV = OSC1_PLL2    ; [Primary Oscillator Src: /1][96 MHz PLL Src: /2]
    CONFIG  USBDIV = 2            ; USB clock source comes from the 96 MHz PLL divided by 2
    CONFIG  FOSC = HSPLL_HS       ; HS oscillator, PLL enabled (HSPLL)
    CONFIG  FCMEN = OFF           ; Fail-Safe Clock Monitor disabled
    CONFIG  IESO = OFF            ; Oscillator Switchover mode disabled
    CONFIG  PWRT = OFF            ; PWRT disabled
    CONFIG  BOR = ON              ; Brown-out Reset enabled in hardware only (SBOREN is disabled)
    CONFIG  BORV = 3              ; Minimum setting
    CONFIG  VREGEN = ON           ; USB voltage regulator enabled
    CONFIG  WDT = ON              ; WDT enabled
    CONFIG  WDTPS = 512           ; 1:512
    CONFIG  CCP2MX = ON           ; CCP2 input/output is multiplexed with RC1
    CONFIG  PBADEN = OFF          ; PORTB<4:0> pins are configured as digital I/O on Reset
    CONFIG  LPT1OSC = OFF         ; Timer1 configured for higher power operation
    CONFIG  MCLRE = ON            ; MCLR pin enabled; RE3 input pin disabled
    CONFIG  STVREN = ON           ; Stack full/underflow will cause Reset
    CONFIG  LVP = OFF             ; Single-Supply ICSP disabled
    CONFIG  XINST = OFF           ; Instruction set extension and Indexed Addressing mode disabled (Legacy mode)
    CONFIG  DEBUG = OFF           ; Background debugger disabled, RB6 and RB7 configured as general purpose I/O pins
    CONFIG  CP0 = OFF             ; Block 0 (000800-001FFFh) is not code-protected
    CONFIG  CP1 = OFF             ; Block 1 (002000-003FFFh) is not code-protected
    CONFIG  CP2 = OFF             ; Block 2 (004000-005FFFh) is not code-protected
    CONFIG  CP3 = OFF             ; Block 3 (006000-007FFFh) is not code-protected
    CONFIG  CPB = OFF             ; Boot block (000000-0007FFh) is not code-protected
    CONFIG  CPD = OFF             ; Data EEPROM is not code-protected
    CONFIG  WRT0 = OFF            ; Block 0 (000800-001FFFh) is not write-protected
    CONFIG  WRT1 = OFF            ; Block 1 (002000-003FFFh) is not write-protected
    CONFIG  WRT2 = OFF            ; Block 2 (004000-005FFFh) is not write-protected
    CONFIG  WRT3 = OFF            ; Block 3 (006000-007FFFh) is not write-protected
    CONFIG  WRTC = OFF            ; Configuration registers (300000-3000FFh) are not write-protected
    CONFIG  WRTB = OFF            ; Boot block (000000-0007FFh) is not write-protected
    CONFIG  WRTD = OFF            ; Data EEPROM is not write-protected
    CONFIG  EBTR0 = OFF           ; Block 0 (000800-001FFFh) is not protected from table reads executed in other blocks
    CONFIG  EBTR1 = OFF           ; Block 1 (002000-003FFFh) is not protected from table reads executed in other blocks
    CONFIG  EBTR2 = OFF           ; Block 2 (004000-005FFFh) is not protected from table reads executed in other blocks
    CONFIG  EBTR3 = OFF           ; Block 3 (006000-007FFFh) is not protected from table reads executed in other blocks
    CONFIG  EBTRB = OFF           ; Boot block (000000-0007FFh) is not protected from table reads executed in other blocks



; Define statements.
; C:\USERS\CONNO\DOCUMENTS\4TH YEAR\PROJECT\PIC CODE\TX_CODE_RESTRUCTURED.PBP	00011	DEFINE OSC 4
#define		OSC		 4

RAM_START       		EQU	00000h
RAM_END         		EQU	007FFh
RAM_BANKS       		EQU	00008h
BANK0_START     		EQU	00060h
BANK0_END       		EQU	000FFh
BANK1_START     		EQU	00100h
BANK1_END       		EQU	001FFh
BANK2_START     		EQU	00200h
BANK2_END       		EQU	002FFh
BANK3_START     		EQU	00300h
BANK3_END       		EQU	003FFh
BANK4_START     		EQU	00400h
BANK4_END       		EQU	004FFh
BANK5_START     		EQU	00500h
BANK5_END       		EQU	005FFh
BANK6_START     		EQU	00600h
BANK6_END       		EQU	006FFh
BANK7_START     		EQU	00700h
BANK7_END       		EQU	007FFh
BANKA_START     		EQU	00000h
BANKA_END       		EQU	0005Fh

; C:\PROGRAM FILES (X86)\PBP3_1\PBPPIC18.RAM	00028	A00000	FLAGS   VAR     BYTE BANKA SYSTEM       ' Static flags
FLAGS           		EQU	RAM_START + 000h
; C:\PROGRAM FILES (X86)\PBP3_1\PBPPIC18.RAM	00027	A00001	GOP     VAR     BYTE BANKA SYSTEM       ' Gen Op Parameter
GOP             		EQU	RAM_START + 001h
; C:\PROGRAM FILES (X86)\PBP3_1\PBPPIC18.RAM	00012	A00002	R0      VAR     WORD BANKA SYSTEM       ' System Register
R0              		EQU	RAM_START + 002h
; C:\PROGRAM FILES (X86)\PBP3_1\PBPPIC18.RAM	00013	A00004	R1      VAR     WORD BANKA SYSTEM       ' System Register
R1              		EQU	RAM_START + 004h
; C:\PROGRAM FILES (X86)\PBP3_1\PBPPIC18.RAM	00014	A00006	R2      VAR     WORD BANKA SYSTEM       ' System Register
R2              		EQU	RAM_START + 006h
; C:\PROGRAM FILES (X86)\PBP3_1\PBPPIC18.RAM	00015	A00008	R3      VAR     WORD BANKA SYSTEM       ' System Register
R3              		EQU	RAM_START + 008h
; C:\PROGRAM FILES (X86)\PBP3_1\PBPPIC18.RAM	00016	A0000A	R4      VAR     WORD BANKA SYSTEM       ' System Register
R4              		EQU	RAM_START + 00Ah
; C:\PROGRAM FILES (X86)\PBP3_1\PBPPIC18.RAM	00017	A0000C	R5      VAR     WORD BANKA SYSTEM       ' System Register
R5              		EQU	RAM_START + 00Ch
; C:\PROGRAM FILES (X86)\PBP3_1\PBPPIC18.RAM	00018	A0000E	R6      VAR     WORD BANKA SYSTEM       ' System Register
R6              		EQU	RAM_START + 00Eh
; C:\PROGRAM FILES (X86)\PBP3_1\PBPPIC18.RAM	00019	A00010	R7      VAR     WORD BANKA SYSTEM       ' System Register
R7              		EQU	RAM_START + 010h
; C:\PROGRAM FILES (X86)\PBP3_1\PBPPIC18.RAM	00020	A00012	R8      VAR     WORD BANKA SYSTEM       ' System Register
R8              		EQU	RAM_START + 012h
; C:\USERS\CONNO\DOCUMENTS\4TH YEAR\PROJECT\PIC CODE\TX_CODE_RESTRUCTURED.PBP	00001	A00014	'****************************************************************
T1              		EQU	RAM_START + 014h
; C:\PROGRAM FILES (X86)\PBP3_1\PBPPIC18.RAM	00023	A00016	RM1     VAR     BYTE BANKA SYSTEM       ' Pin 1 Mask
RM1             		EQU	RAM_START + 016h
; C:\PROGRAM FILES (X86)\PBP3_1\PBPPIC18.RAM	00026	A00017	RM2     VAR     BYTE BANKA SYSTEM       ' Pin 2 Mask
RM2             		EQU	RAM_START + 017h
; C:\PROGRAM FILES (X86)\PBP3_1\PBPPIC18.RAM	00021	A00018	RR1     VAR     BYTE BANKA SYSTEM       ' Pin 1 Register
RR1             		EQU	RAM_START + 018h
; C:\PROGRAM FILES (X86)\PBP3_1\PBPPIC18.RAM	00024	A00019	RR2     VAR     BYTE BANKA SYSTEM       ' Pin 2 Register
RR2             		EQU	RAM_START + 019h
; C:\PROGRAM FILES (X86)\PBP3_1\PBPPIC18.RAM	00022	A0001A	RS1     VAR     BYTE BANKA SYSTEM       ' Pin 1 Bank
RS1             		EQU	RAM_START + 01Ah
; C:\PROGRAM FILES (X86)\PBP3_1\PBPPIC18.RAM	00025	A0001B	RS2     VAR     BYTE BANKA SYSTEM       ' Pin 2 Bank
RS2             		EQU	RAM_START + 01Bh
; C:\USERS\CONNO\DOCUMENTS\4TH YEAR\PROJECT\PIC CODE\TX_CODE_RESTRUCTURED.PBP	00021	A0001C	    A var word
_A               		EQU	RAM_START + 01Ch
; C:\USERS\CONNO\DOCUMENTS\4TH YEAR\PROJECT\PIC CODE\TX_CODE_RESTRUCTURED.PBP	00022	A0001E	    B var word
_B               		EQU	RAM_START + 01Eh
; C:\USERS\CONNO\DOCUMENTS\4TH YEAR\PROJECT\PIC CODE\TX_CODE_RESTRUCTURED.PBP	00028	A00020	    light var word
_light           		EQU	RAM_START + 020h
; C:\USERS\CONNO\DOCUMENTS\4TH YEAR\PROJECT\PIC CODE\TX_CODE_RESTRUCTURED.PBP	00023	A00022	    temp var word
_temp            		EQU	RAM_START + 022h
; C:\USERS\CONNO\DOCUMENTS\4TH YEAR\PROJECT\PIC CODE\TX_CODE_RESTRUCTURED.PBP	00032	A00024	    time var word
_time            		EQU	RAM_START + 024h
; C:\USERS\CONNO\DOCUMENTS\4TH YEAR\PROJECT\PIC CODE\TX_CODE_RESTRUCTURED.PBP	00031	A00026	    volts var word
_volts           		EQU	RAM_START + 026h
; C:\USERS\CONNO\DOCUMENTS\4TH YEAR\PROJECT\PIC CODE\TX_CODE_RESTRUCTURED.PBP	00033	A00028	    counting var byte
_counting        		EQU	RAM_START + 028h
; C:\USERS\CONNO\DOCUMENTS\4TH YEAR\PROJECT\PIC CODE\TX_CODE_RESTRUCTURED.PBP	00029	A00029	    lightA var byte
_lightA          		EQU	RAM_START + 029h
; C:\USERS\CONNO\DOCUMENTS\4TH YEAR\PROJECT\PIC CODE\TX_CODE_RESTRUCTURED.PBP	00030	A0002A	    lightB var byte
_lightB          		EQU	RAM_START + 02Ah
; C:\USERS\CONNO\DOCUMENTS\4TH YEAR\PROJECT\PIC CODE\TX_CODE_RESTRUCTURED.PBP	00024	A0002B	    tempA var byte
_tempA           		EQU	RAM_START + 02Bh
; C:\USERS\CONNO\DOCUMENTS\4TH YEAR\PROJECT\PIC CODE\TX_CODE_RESTRUCTURED.PBP	00025	A0002C	    tempB var byte
_tempB           		EQU	RAM_START + 02Ch
; C:\USERS\CONNO\DOCUMENTS\4TH YEAR\PROJECT\PIC CODE\TX_CODE_RESTRUCTURED.PBP	00026	A0002D	    voltsA var byte
_voltsA          		EQU	RAM_START + 02Dh
; C:\USERS\CONNO\DOCUMENTS\4TH YEAR\PROJECT\PIC CODE\TX_CODE_RESTRUCTURED.PBP	00027	A0002E	    voltsB var byte
_voltsB          		EQU	RAM_START + 02Eh
; C:\PROGRAM FILES (X86)\PBP3_1\DEVICES\PIC18F2550.PBPINC	00289	PORTL   VAR     PORTB
_PORTL           		EQU	 PORTB
; C:\PROGRAM FILES (X86)\PBP3_1\DEVICES\PIC18F2550.PBPINC	00290	PORTH   VAR     PORTC
_PORTH           		EQU	 PORTC
; C:\PROGRAM FILES (X86)\PBP3_1\DEVICES\PIC18F2550.PBPINC	00291	TRISL   VAR     TRISB
_TRISL           		EQU	 TRISB
; C:\PROGRAM FILES (X86)\PBP3_1\DEVICES\PIC18F2550.PBPINC	00292	TRISH   VAR     TRISC
_TRISH           		EQU	 TRISC
#define _led             	_PORTB??0
#define _tilt            	_PORTB??1
#define _Piezo           	_PORTB??2
#define _arduino         	_PORTB??3
#define _light_signal    	_PORTA??0
#define _temp_signal     	_PORTA??1
#define _battery_signal  	_PORTA??2
#define _PORTB??0        	 PORTB, 000h
#define _PORTB??1        	 PORTB, 001h
#define _PORTB??2        	 PORTB, 002h
#define _PORTB??3        	 PORTB, 003h
#define _PORTA??0        	 PORTA, 000h
#define _PORTA??1        	 PORTA, 001h
#define _PORTA??2        	 PORTA, 002h

; Constants.
_USBMEMORYADDRESS		EQU	00400h
_cycles          		EQU	0003Ch

; EEPROM data.


	INCLUDE	"TX_CODE_RESTRUCTURED.MAC"
	INCLUDE	"C:\PROGRAM FILES (X86)\PBP3_1\PBPPIC18.LIB"


; C:\PROGRAM FILES (X86)\PBP3_1\DEVICES\PIC18F2550.PBPINC	00036	#HEADER
; C:\PROGRAM FILES (X86)\PBP3_1\DEVICES\PIC18F2550.PBPINC	00061	#CONFIG
; C:\PROGRAM FILES (X86)\PBP3_1\DEVICES\PIC18F2550.PBPINC	00270	BANKA   $0000, $005F
; C:\PROGRAM FILES (X86)\PBP3_1\DEVICES\PIC18F2550.PBPINC	00271	BANK0   $0060, $00FF
; C:\PROGRAM FILES (X86)\PBP3_1\DEVICES\PIC18F2550.PBPINC	00272	BANK1   $0100, $01FF
; C:\PROGRAM FILES (X86)\PBP3_1\DEVICES\PIC18F2550.PBPINC	00273	BANK2   $0200, $02FF
; C:\PROGRAM FILES (X86)\PBP3_1\DEVICES\PIC18F2550.PBPINC	00274	BANK3   $0300, $03FF
; C:\PROGRAM FILES (X86)\PBP3_1\DEVICES\PIC18F2550.PBPINC	00275	BANK4   $0400, $04FF
; C:\PROGRAM FILES (X86)\PBP3_1\DEVICES\PIC18F2550.PBPINC	00276	BANK5   $0500, $05FF
; C:\PROGRAM FILES (X86)\PBP3_1\DEVICES\PIC18F2550.PBPINC	00277	BANK6   $0600, $06FF
; C:\PROGRAM FILES (X86)\PBP3_1\DEVICES\PIC18F2550.PBPINC	00278	BANK7   $0700, $07FF
; C:\PROGRAM FILES (X86)\PBP3_1\DEVICES\PIC18F2550.PBPINC	00284	    INCLUDE "PBPPI18L.RAM"
; C:\PROGRAM FILES (X86)\PBP3_1\DEVICES\PIC18F2550.PBPINC	00285	#ELSE
; C:\PROGRAM FILES (X86)\PBP3_1\DEVICES\PIC18F2550.PBPINC	00286	    LIBRARY  "PBPPIC18"

; C:\PROGRAM FILES (X86)\PBP3_1\DEVICES\PIC18F2550.PBPINC	00287	    INCLUDE "PBPPIC18.RAM"
; C:\PROGRAM FILES (X86)\PBP3_1\DEVICES\PIC18F2550.PBPINC	00288	#ENDIF
; C:\PROGRAM FILES (X86)\PBP3_1\DEVICES\PIC18F2550.PBPINC	00293	USBMEMORYADDRESS Con	$400	' USB RAM starts here
; C:\PROGRAM FILES (X86)\PBP3_1\DEVICES\PIC18F2550.PBPINC	00297	#HEADER
; C:\USERS\CONNO\DOCUMENTS\4TH YEAR\PROJECT\PIC CODE\TX_CODE_RESTRUCTURED.PBP	00011	DEFINE OSC 4

; C:\USERS\CONNO\DOCUMENTS\4TH YEAR\PROJECT\PIC CODE\TX_CODE_RESTRUCTURED.PBP	00012	OSCCON=%01100010
	MOVE?CB	062h, OSCCON

; C:\USERS\CONNO\DOCUMENTS\4TH YEAR\PROJECT\PIC CODE\TX_CODE_RESTRUCTURED.PBP	00013	ADCON1=%00001100
	MOVE?CB	00Ch, ADCON1

; C:\USERS\CONNO\DOCUMENTS\4TH YEAR\PROJECT\PIC CODE\TX_CODE_RESTRUCTURED.PBP	00014	ADCON2=%10010000
	MOVE?CB	090h, ADCON2

; C:\USERS\CONNO\DOCUMENTS\4TH YEAR\PROJECT\PIC CODE\TX_CODE_RESTRUCTURED.PBP	00015	CVRCON=%00000000
	MOVE?CB	000h, CVRCON

; C:\USERS\CONNO\DOCUMENTS\4TH YEAR\PROJECT\PIC CODE\TX_CODE_RESTRUCTURED.PBP	00016	HLVDCON=%00000000
	MOVE?CB	000h, HLVDCON

; C:\USERS\CONNO\DOCUMENTS\4TH YEAR\PROJECT\PIC CODE\TX_CODE_RESTRUCTURED.PBP	00017	init:

	LABEL?L	_init	

; C:\USERS\CONNO\DOCUMENTS\4TH YEAR\PROJECT\PIC CODE\TX_CODE_RESTRUCTURED.PBP	00018	    TRISB=%00000110
	MOVE?CB	006h, TRISB

; C:\USERS\CONNO\DOCUMENTS\4TH YEAR\PROJECT\PIC CODE\TX_CODE_RESTRUCTURED.PBP	00019	    TRISC=%00000000
	MOVE?CB	000h, TRISC
; C:\USERS\CONNO\DOCUMENTS\4TH YEAR\PROJECT\PIC CODE\TX_CODE_RESTRUCTURED.PBP	00043	    cycles con 60

; C:\USERS\CONNO\DOCUMENTS\4TH YEAR\PROJECT\PIC CODE\TX_CODE_RESTRUCTURED.PBP	00044	    time=0
	MOVE?CW	000h, _time

; C:\USERS\CONNO\DOCUMENTS\4TH YEAR\PROJECT\PIC CODE\TX_CODE_RESTRUCTURED.PBP	00045	    counting=0
	MOVE?CB	000h, _counting

; C:\USERS\CONNO\DOCUMENTS\4TH YEAR\PROJECT\PIC CODE\TX_CODE_RESTRUCTURED.PBP	00046	    arduino=0
	MOVE?CT	000h, _arduino

; C:\USERS\CONNO\DOCUMENTS\4TH YEAR\PROJECT\PIC CODE\TX_CODE_RESTRUCTURED.PBP	00048	cycle:

	LABEL?L	_cycle	

; C:\USERS\CONNO\DOCUMENTS\4TH YEAR\PROJECT\PIC CODE\TX_CODE_RESTRUCTURED.PBP	00051	    if time>=2000 then 
	CMPLT?WCL	_time, 007D0h, L00001

; C:\USERS\CONNO\DOCUMENTS\4TH YEAR\PROJECT\PIC CODE\TX_CODE_RESTRUCTURED.PBP	00052	        led=1
	MOVE?CT	001h, _led

; C:\USERS\CONNO\DOCUMENTS\4TH YEAR\PROJECT\PIC CODE\TX_CODE_RESTRUCTURED.PBP	00053	        pause 3000
	PAUSE?C	00BB8h

; C:\USERS\CONNO\DOCUMENTS\4TH YEAR\PROJECT\PIC CODE\TX_CODE_RESTRUCTURED.PBP	00054	        gosub sleep_time
	GOSUB?L	_sleep_time

; C:\USERS\CONNO\DOCUMENTS\4TH YEAR\PROJECT\PIC CODE\TX_CODE_RESTRUCTURED.PBP	00055	        pause 75    
	PAUSE?C	04Bh

; C:\USERS\CONNO\DOCUMENTS\4TH YEAR\PROJECT\PIC CODE\TX_CODE_RESTRUCTURED.PBP	00057	    elseif tilt==0 then
	GOTO?L	L00002
	LABEL?L	L00001	
	CMPNE?TCL	_tilt, 000h, L00003

; C:\USERS\CONNO\DOCUMENTS\4TH YEAR\PROJECT\PIC CODE\TX_CODE_RESTRUCTURED.PBP	00061	        time=time+20
	ADD?WCW	_time, 014h, _time

; C:\USERS\CONNO\DOCUMENTS\4TH YEAR\PROJECT\PIC CODE\TX_CODE_RESTRUCTURED.PBP	00062	    endif
	LABEL?L	L00002	
	LABEL?L	L00003	

; C:\USERS\CONNO\DOCUMENTS\4TH YEAR\PROJECT\PIC CODE\TX_CODE_RESTRUCTURED.PBP	00065	    if Piezo ==1 then
	CMPNE?TCL	_Piezo, 001h, L00005

; C:\USERS\CONNO\DOCUMENTS\4TH YEAR\PROJECT\PIC CODE\TX_CODE_RESTRUCTURED.PBP	00067	        time=0
	MOVE?CW	000h, _time

; C:\USERS\CONNO\DOCUMENTS\4TH YEAR\PROJECT\PIC CODE\TX_CODE_RESTRUCTURED.PBP	00068	        counting=0
	MOVE?CB	000h, _counting

; C:\USERS\CONNO\DOCUMENTS\4TH YEAR\PROJECT\PIC CODE\TX_CODE_RESTRUCTURED.PBP	00069	        light=0
	MOVE?CW	000h, _light

; C:\USERS\CONNO\DOCUMENTS\4TH YEAR\PROJECT\PIC CODE\TX_CODE_RESTRUCTURED.PBP	00071	        gosub tempscan
	GOSUB?L	_tempscan

; C:\USERS\CONNO\DOCUMENTS\4TH YEAR\PROJECT\PIC CODE\TX_CODE_RESTRUCTURED.PBP	00072	        gosub batteryscan
	GOSUB?L	_batteryscan

; C:\USERS\CONNO\DOCUMENTS\4TH YEAR\PROJECT\PIC CODE\TX_CODE_RESTRUCTURED.PBP	00073	        while counting<=cycles
	LABEL?L	L00007	
	CMPGT?BCL	_counting, _cycles, L00008

; C:\USERS\CONNO\DOCUMENTS\4TH YEAR\PROJECT\PIC CODE\TX_CODE_RESTRUCTURED.PBP	00074	            counting=counting+1
	ADD?BCB	_counting, 001h, _counting

; C:\USERS\CONNO\DOCUMENTS\4TH YEAR\PROJECT\PIC CODE\TX_CODE_RESTRUCTURED.PBP	00075	            gosub obtain
	GOSUB?L	_obtain

; C:\USERS\CONNO\DOCUMENTS\4TH YEAR\PROJECT\PIC CODE\TX_CODE_RESTRUCTURED.PBP	00076	            if A>B then
	CMPLE?WWL	_A, _B, L00009

; C:\USERS\CONNO\DOCUMENTS\4TH YEAR\PROJECT\PIC CODE\TX_CODE_RESTRUCTURED.PBP	00077	                light = (A-B) + light
	SUB?WWW	_A, _B, T1
	ADD?WWW	T1, _light, _light

; C:\USERS\CONNO\DOCUMENTS\4TH YEAR\PROJECT\PIC CODE\TX_CODE_RESTRUCTURED.PBP	00078	            endif 
	LABEL?L	L00009	

; C:\USERS\CONNO\DOCUMENTS\4TH YEAR\PROJECT\PIC CODE\TX_CODE_RESTRUCTURED.PBP	00079	        wend
	GOTO?L	L00007
	LABEL?L	L00008	

; C:\USERS\CONNO\DOCUMENTS\4TH YEAR\PROJECT\PIC CODE\TX_CODE_RESTRUCTURED.PBP	00080	        light= light/cycles 
	DIV?WCW	_light, _cycles, _light

; C:\USERS\CONNO\DOCUMENTS\4TH YEAR\PROJECT\PIC CODE\TX_CODE_RESTRUCTURED.PBP	00081	        lightA=light
	MOVE?WB	_light, _lightA

; C:\USERS\CONNO\DOCUMENTS\4TH YEAR\PROJECT\PIC CODE\TX_CODE_RESTRUCTURED.PBP	00082	        lightB=light>>8
	SHIFTR?WCB	_light, 008h, _lightB

; C:\USERS\CONNO\DOCUMENTS\4TH YEAR\PROJECT\PIC CODE\TX_CODE_RESTRUCTURED.PBP	00083	        tempA=temp
	MOVE?WB	_temp, _tempA

; C:\USERS\CONNO\DOCUMENTS\4TH YEAR\PROJECT\PIC CODE\TX_CODE_RESTRUCTURED.PBP	00084	        tempB=temp>>8
	SHIFTR?WCB	_temp, 008h, _tempB

; C:\USERS\CONNO\DOCUMENTS\4TH YEAR\PROJECT\PIC CODE\TX_CODE_RESTRUCTURED.PBP	00085	        voltsA=volts
	MOVE?WB	_volts, _voltsA

; C:\USERS\CONNO\DOCUMENTS\4TH YEAR\PROJECT\PIC CODE\TX_CODE_RESTRUCTURED.PBP	00086	        voltsB=volts>>8
	SHIFTR?WCB	_volts, 008h, _voltsB

; C:\USERS\CONNO\DOCUMENTS\4TH YEAR\PROJECT\PIC CODE\TX_CODE_RESTRUCTURED.PBP	00087	        gosub send_nothing
	GOSUB?L	_send_nothing

; C:\USERS\CONNO\DOCUMENTS\4TH YEAR\PROJECT\PIC CODE\TX_CODE_RESTRUCTURED.PBP	00088	        pause 75
	PAUSE?C	04Bh

; C:\USERS\CONNO\DOCUMENTS\4TH YEAR\PROJECT\PIC CODE\TX_CODE_RESTRUCTURED.PBP	00090	        gosub send    
	GOSUB?L	_send

; C:\USERS\CONNO\DOCUMENTS\4TH YEAR\PROJECT\PIC CODE\TX_CODE_RESTRUCTURED.PBP	00092	    else
	GOTO?L	L00006
	LABEL?L	L00005	

; C:\USERS\CONNO\DOCUMENTS\4TH YEAR\PROJECT\PIC CODE\TX_CODE_RESTRUCTURED.PBP	00093	        gosub send_nothing
	GOSUB?L	_send_nothing

; C:\USERS\CONNO\DOCUMENTS\4TH YEAR\PROJECT\PIC CODE\TX_CODE_RESTRUCTURED.PBP	00094	        time=time+4
	ADD?WCW	_time, 004h, _time

; C:\USERS\CONNO\DOCUMENTS\4TH YEAR\PROJECT\PIC CODE\TX_CODE_RESTRUCTURED.PBP	00095	    endif   
	LABEL?L	L00006	

; C:\USERS\CONNO\DOCUMENTS\4TH YEAR\PROJECT\PIC CODE\TX_CODE_RESTRUCTURED.PBP	00097	    pause 75
	PAUSE?C	04Bh

; C:\USERS\CONNO\DOCUMENTS\4TH YEAR\PROJECT\PIC CODE\TX_CODE_RESTRUCTURED.PBP	00098	    goto cycle
	GOTO?L	_cycle

; C:\USERS\CONNO\DOCUMENTS\4TH YEAR\PROJECT\PIC CODE\TX_CODE_RESTRUCTURED.PBP	00101	send:                        'sends data in 8 bit numbers

	LABEL?L	_send	

; C:\USERS\CONNO\DOCUMENTS\4TH YEAR\PROJECT\PIC CODE\TX_CODE_RESTRUCTURED.PBP	00102	    serout arduino, 4,["H",lightA,lightB,tempA,tempB,voltsA,voltsB,"I"]'X,X,X,X,X,X,X,cycles, cycles, Y,cycles, Y,X,X]'header]',total,temp,volts]', total, temp, volt
	SERPIN?T	_arduino
	SERMODE?C	004h
	SEROUT?C	048h
	SEROUT?B	_lightA
	SEROUT?B	_lightB
	SEROUT?B	_tempA
	SEROUT?B	_tempB
	SEROUT?B	_voltsA
	SEROUT?B	_voltsB
	SEROUT?C	049h

; C:\USERS\CONNO\DOCUMENTS\4TH YEAR\PROJECT\PIC CODE\TX_CODE_RESTRUCTURED.PBP	00104	    return
	RETURN?	

; C:\USERS\CONNO\DOCUMENTS\4TH YEAR\PROJECT\PIC CODE\TX_CODE_RESTRUCTURED.PBP	00106	send_nothing:      'sends a placeholder in order to block error signals

	LABEL?L	_send_nothing	

; C:\USERS\CONNO\DOCUMENTS\4TH YEAR\PROJECT\PIC CODE\TX_CODE_RESTRUCTURED.PBP	00107	    serout arduino, 4,["N"]
	SERPIN?T	_arduino
	SERMODE?C	004h
	SEROUT?C	04Eh

; C:\USERS\CONNO\DOCUMENTS\4TH YEAR\PROJECT\PIC CODE\TX_CODE_RESTRUCTURED.PBP	00108	    return
	RETURN?	

; C:\USERS\CONNO\DOCUMENTS\4TH YEAR\PROJECT\PIC CODE\TX_CODE_RESTRUCTURED.PBP	00110	sleep_time:

	LABEL?L	_sleep_time	

; C:\USERS\CONNO\DOCUMENTS\4TH YEAR\PROJECT\PIC CODE\TX_CODE_RESTRUCTURED.PBP	00111	    led=0
	MOVE?CT	000h, _led

; C:\USERS\CONNO\DOCUMENTS\4TH YEAR\PROJECT\PIC CODE\TX_CODE_RESTRUCTURED.PBP	00112	    serout arduino, 4,["T","T","T","T"]
	SERPIN?T	_arduino
	SERMODE?C	004h
	SEROUT?C	054h
	SEROUT?C	054h
	SEROUT?C	054h
	SEROUT?C	054h

; C:\USERS\CONNO\DOCUMENTS\4TH YEAR\PROJECT\PIC CODE\TX_CODE_RESTRUCTURED.PBP	00113	    pause 75
	PAUSE?C	04Bh

; C:\USERS\CONNO\DOCUMENTS\4TH YEAR\PROJECT\PIC CODE\TX_CODE_RESTRUCTURED.PBP	00114	    serout arduino, 4,["T","T","T","T"]
	SERPIN?T	_arduino
	SERMODE?C	004h
	SEROUT?C	054h
	SEROUT?C	054h
	SEROUT?C	054h
	SEROUT?C	054h

; C:\USERS\CONNO\DOCUMENTS\4TH YEAR\PROJECT\PIC CODE\TX_CODE_RESTRUCTURED.PBP	00115	    pause 75
	PAUSE?C	04Bh

; C:\USERS\CONNO\DOCUMENTS\4TH YEAR\PROJECT\PIC CODE\TX_CODE_RESTRUCTURED.PBP	00116	    serout arduino, 4,["T","T","T","T"]
	SERPIN?T	_arduino
	SERMODE?C	004h
	SEROUT?C	054h
	SEROUT?C	054h
	SEROUT?C	054h
	SEROUT?C	054h

; C:\USERS\CONNO\DOCUMENTS\4TH YEAR\PROJECT\PIC CODE\TX_CODE_RESTRUCTURED.PBP	00122	        INTCON2=%11110101
	MOVE?CB	0F5h, INTCON2

; C:\USERS\CONNO\DOCUMENTS\4TH YEAR\PROJECT\PIC CODE\TX_CODE_RESTRUCTURED.PBP	00123	        INTCON3=%01001000
	MOVE?CB	048h, INTCON3

; C:\USERS\CONNO\DOCUMENTS\4TH YEAR\PROJECT\PIC CODE\TX_CODE_RESTRUCTURED.PBP	00124	        sleep 65000
	SLEEP?C	0FDE8h

; C:\USERS\CONNO\DOCUMENTS\4TH YEAR\PROJECT\PIC CODE\TX_CODE_RESTRUCTURED.PBP	00125	        INTCON3=%00000000  
	MOVE?CB	000h, INTCON3

; C:\USERS\CONNO\DOCUMENTS\4TH YEAR\PROJECT\PIC CODE\TX_CODE_RESTRUCTURED.PBP	00127	    gosub send_nothing
	GOSUB?L	_send_nothing

; C:\USERS\CONNO\DOCUMENTS\4TH YEAR\PROJECT\PIC CODE\TX_CODE_RESTRUCTURED.PBP	00128	    time=0
	MOVE?CW	000h, _time

; C:\USERS\CONNO\DOCUMENTS\4TH YEAR\PROJECT\PIC CODE\TX_CODE_RESTRUCTURED.PBP	00129	    return   
	RETURN?	

; C:\USERS\CONNO\DOCUMENTS\4TH YEAR\PROJECT\PIC CODE\TX_CODE_RESTRUCTURED.PBP	00131	lightscan:

	LABEL?L	_lightscan	

; C:\USERS\CONNO\DOCUMENTS\4TH YEAR\PROJECT\PIC CODE\TX_CODE_RESTRUCTURED.PBP	00132	    ADCON0= %00000001
	MOVE?CB	001h, ADCON0

; C:\USERS\CONNO\DOCUMENTS\4TH YEAR\PROJECT\PIC CODE\TX_CODE_RESTRUCTURED.PBP	00133	    ADCON0= %00000011
	MOVE?CB	003h, ADCON0

; C:\USERS\CONNO\DOCUMENTS\4TH YEAR\PROJECT\PIC CODE\TX_CODE_RESTRUCTURED.PBP	00134	    while ADCON0 != %00000001
	LABEL?L	L00011	
	CMPEQ?BCL	ADCON0, 001h, L00012

; C:\USERS\CONNO\DOCUMENTS\4TH YEAR\PROJECT\PIC CODE\TX_CODE_RESTRUCTURED.PBP	00135	        light=light
	MOVE?WW	_light, _light

; C:\USERS\CONNO\DOCUMENTS\4TH YEAR\PROJECT\PIC CODE\TX_CODE_RESTRUCTURED.PBP	00136	    wend
	GOTO?L	L00011
	LABEL?L	L00012	

; C:\USERS\CONNO\DOCUMENTS\4TH YEAR\PROJECT\PIC CODE\TX_CODE_RESTRUCTURED.PBP	00137	    A= ADRESL + ADRESH*256
	MUL?BCW	ADRESH, 00100h, T1
	ADD?BWW	ADRESL, T1, _A

; C:\USERS\CONNO\DOCUMENTS\4TH YEAR\PROJECT\PIC CODE\TX_CODE_RESTRUCTURED.PBP	00138	    ADCON0= %00000000
	MOVE?CB	000h, ADCON0

; C:\USERS\CONNO\DOCUMENTS\4TH YEAR\PROJECT\PIC CODE\TX_CODE_RESTRUCTURED.PBP	00139	    return 
	RETURN?	

; C:\USERS\CONNO\DOCUMENTS\4TH YEAR\PROJECT\PIC CODE\TX_CODE_RESTRUCTURED.PBP	00141	tempscan:

	LABEL?L	_tempscan	

; C:\USERS\CONNO\DOCUMENTS\4TH YEAR\PROJECT\PIC CODE\TX_CODE_RESTRUCTURED.PBP	00142	    ADCON0= %00000101
	MOVE?CB	005h, ADCON0

; C:\USERS\CONNO\DOCUMENTS\4TH YEAR\PROJECT\PIC CODE\TX_CODE_RESTRUCTURED.PBP	00143	    ADCON0 =%00000111
	MOVE?CB	007h, ADCON0

; C:\USERS\CONNO\DOCUMENTS\4TH YEAR\PROJECT\PIC CODE\TX_CODE_RESTRUCTURED.PBP	00144	    while ADCON0 != %00000101
	LABEL?L	L00013	
	CMPEQ?BCL	ADCON0, 005h, L00014

; C:\USERS\CONNO\DOCUMENTS\4TH YEAR\PROJECT\PIC CODE\TX_CODE_RESTRUCTURED.PBP	00145	        temp=temp
	MOVE?WW	_temp, _temp

; C:\USERS\CONNO\DOCUMENTS\4TH YEAR\PROJECT\PIC CODE\TX_CODE_RESTRUCTURED.PBP	00146	    wend
	GOTO?L	L00013
	LABEL?L	L00014	

; C:\USERS\CONNO\DOCUMENTS\4TH YEAR\PROJECT\PIC CODE\TX_CODE_RESTRUCTURED.PBP	00147	    temp= ADRESL + ADRESH*256
	MUL?BCW	ADRESH, 00100h, T1
	ADD?BWW	ADRESL, T1, _temp

; C:\USERS\CONNO\DOCUMENTS\4TH YEAR\PROJECT\PIC CODE\TX_CODE_RESTRUCTURED.PBP	00148	    ADCON0= %00000100
	MOVE?CB	004h, ADCON0

; C:\USERS\CONNO\DOCUMENTS\4TH YEAR\PROJECT\PIC CODE\TX_CODE_RESTRUCTURED.PBP	00149	    return
	RETURN?	

; C:\USERS\CONNO\DOCUMENTS\4TH YEAR\PROJECT\PIC CODE\TX_CODE_RESTRUCTURED.PBP	00151	obtain:

	LABEL?L	_obtain	

; C:\USERS\CONNO\DOCUMENTS\4TH YEAR\PROJECT\PIC CODE\TX_CODE_RESTRUCTURED.PBP	00152	    led=0
	MOVE?CT	000h, _led

; C:\USERS\CONNO\DOCUMENTS\4TH YEAR\PROJECT\PIC CODE\TX_CODE_RESTRUCTURED.PBP	00153	    pauseus 400
	PAUSEUS?C	00190h

; C:\USERS\CONNO\DOCUMENTS\4TH YEAR\PROJECT\PIC CODE\TX_CODE_RESTRUCTURED.PBP	00154	    gosub lightscan
	GOSUB?L	_lightscan

; C:\USERS\CONNO\DOCUMENTS\4TH YEAR\PROJECT\PIC CODE\TX_CODE_RESTRUCTURED.PBP	00155	    B=A
	MOVE?WW	_A, _B

; C:\USERS\CONNO\DOCUMENTS\4TH YEAR\PROJECT\PIC CODE\TX_CODE_RESTRUCTURED.PBP	00156	    led=1
	MOVE?CT	001h, _led

; C:\USERS\CONNO\DOCUMENTS\4TH YEAR\PROJECT\PIC CODE\TX_CODE_RESTRUCTURED.PBP	00157	    pauseus 400
	PAUSEUS?C	00190h

; C:\USERS\CONNO\DOCUMENTS\4TH YEAR\PROJECT\PIC CODE\TX_CODE_RESTRUCTURED.PBP	00158	    gosub lightscan
	GOSUB?L	_lightscan

; C:\USERS\CONNO\DOCUMENTS\4TH YEAR\PROJECT\PIC CODE\TX_CODE_RESTRUCTURED.PBP	00159	    led=0
	MOVE?CT	000h, _led

; C:\USERS\CONNO\DOCUMENTS\4TH YEAR\PROJECT\PIC CODE\TX_CODE_RESTRUCTURED.PBP	00160	    return
	RETURN?	

; C:\USERS\CONNO\DOCUMENTS\4TH YEAR\PROJECT\PIC CODE\TX_CODE_RESTRUCTURED.PBP	00162	batteryscan:

	LABEL?L	_batteryscan	

; C:\USERS\CONNO\DOCUMENTS\4TH YEAR\PROJECT\PIC CODE\TX_CODE_RESTRUCTURED.PBP	00163	    ADCON0 = %00001001
	MOVE?CB	009h, ADCON0

; C:\USERS\CONNO\DOCUMENTS\4TH YEAR\PROJECT\PIC CODE\TX_CODE_RESTRUCTURED.PBP	00164	    ADCON0 = %00001011
	MOVE?CB	00Bh, ADCON0

; C:\USERS\CONNO\DOCUMENTS\4TH YEAR\PROJECT\PIC CODE\TX_CODE_RESTRUCTURED.PBP	00165	    while ADCON0 != %00001001
	LABEL?L	L00015	
	CMPEQ?BCL	ADCON0, 009h, L00016

; C:\USERS\CONNO\DOCUMENTS\4TH YEAR\PROJECT\PIC CODE\TX_CODE_RESTRUCTURED.PBP	00166	        volts=volts
	MOVE?WW	_volts, _volts

; C:\USERS\CONNO\DOCUMENTS\4TH YEAR\PROJECT\PIC CODE\TX_CODE_RESTRUCTURED.PBP	00167	    wend
	GOTO?L	L00015
	LABEL?L	L00016	

; C:\USERS\CONNO\DOCUMENTS\4TH YEAR\PROJECT\PIC CODE\TX_CODE_RESTRUCTURED.PBP	00168	    volts= ADRESL + ADRESH*256
	MUL?BCW	ADRESH, 00100h, T1
	ADD?BWW	ADRESL, T1, _volts

; C:\USERS\CONNO\DOCUMENTS\4TH YEAR\PROJECT\PIC CODE\TX_CODE_RESTRUCTURED.PBP	00169	    ADCON0= %00001000
	MOVE?CB	008h, ADCON0

; C:\USERS\CONNO\DOCUMENTS\4TH YEAR\PROJECT\PIC CODE\TX_CODE_RESTRUCTURED.PBP	00170	    return
	RETURN?	

	END
